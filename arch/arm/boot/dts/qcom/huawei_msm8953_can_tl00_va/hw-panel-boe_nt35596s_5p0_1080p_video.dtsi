/* Copyright (c) 2013, The Linux Foundation. All rights reserved.
 *
 * This program is free software; you can redistribute it and/or modify
 * it under the terms of the GNU General Public License version 2 and
 * only version 2 as published by the Free Software Foundation.
 *
 * This program is distributed in the hope that it will be useful,
 * but WITHOUT ANY WARRANTY; without even the implied warranty of
 * MERCHANTABILITY or FITNESS FOR A PARTICULAR PURPOSE.  See the
 * GNU General Public License for more details.
 */

/*---------------------------------------------------------------------------
 * This file is autogenerated file using gcdb parser. Please do not edit it.
 * Update input XML file to add a new entry or update variable in this file
 * VERSION = "1.0"
 *---------------------------------------------------------------------------*/
&mdss_mdp {
	dsi_boe_nt35596s_5p0_1080p_video: qcom,mdss_dsi_boe_nt35596s_5p0_1080p_video {
		qcom,mdss-dsi-panel-name = "BOE_NT35596S_5P0_1080P_VIDEO";
		qcom,cont-splash-enabled;
		qcom,mdss-dsi-panel-controller = <&mdss_dsi0>;
		qcom,panel-supply-entries = <&dsi_panel_pwr_supply>;
		qcom,mdss-dsi-panel-type = "dsi_video_mode";
		qcom,mdss-dsi-panel-destination = "display_1";
		qcom,mdss-dsi-panel-clockrate = <898000000>;
		qcom,mdss-dsi-panel-framerate = <60>;
		qcom,mdss-dsi-virtual-channel-id = <0>;
		qcom,mdss-dsi-stream = <0>;
		qcom,mdss-dsi-panel-width = <1080>;
		qcom,mdss-dsi-panel-height = <1920>;
		qcom,mdss-dsi-h-front-porch = <114>;
		qcom,mdss-dsi-h-back-porch = <50>;
		qcom,mdss-dsi-h-pulse-width = <8>;
		qcom,mdss-dsi-h-sync-skew = <0>;
		qcom,mdss-dsi-v-back-porch = <6>;
		qcom,mdss-dsi-v-front-porch = <8>;
		qcom,mdss-dsi-v-pulse-width = <4>;
		qcom,mdss-dsi-h-left-border = <0>;
		qcom,mdss-dsi-h-right-border = <0>;
		qcom,mdss-dsi-v-top-border = <0>;
		qcom,mdss-dsi-v-bottom-border = <0>;
		qcom,mdss-dsi-bpp = <24>;
		qcom,mdss-dsi-underflow-color = <0x00>;
		qcom,mdss-dsi-border-color = <0>;
		qcom,mdss-dsi-color-order = "rgb_swap_rgb";
		qcom,mdss-dsi-on-command = [39 01 00 00 00 00 02 FF E0
                                        39 01 00 00 01 00 02 4F 01
                                        39 01 00 00 01 00 02 4F 00
                                        39 01 00 00 00 00 02 FF 2E
                                        39 01 00 00 00 00 02 FB 01
                                        39 01 00 00 00 00 02 03 0A
                                        39 01 00 00 00 00 02 67 0C
                                        29 01 00 00 00 00 02 FF 20
                                        29 01 00 00 00 00 02 FB 01
                                        29 01 00 00 00 00 02 75 00
                                        29 01 00 00 00 00 02 76 00
                                        29 01 00 00 00 00 02 77 00
                                        29 01 00 00 00 00 02 78 16
                                        29 01 00 00 00 00 02 79 00
                                        29 01 00 00 00 00 02 7A 36
                                        29 01 00 00 00 00 02 7B 00
                                        29 01 00 00 00 00 02 7C 50
                                        29 01 00 00 00 00 02 7D 00
                                        29 01 00 00 00 00 02 7E 66
                                        29 01 00 00 00 00 02 7F 00
                                        29 01 00 00 00 00 02 80 7A
                                        29 01 00 00 00 00 02 81 00
                                        29 01 00 00 00 00 02 82 8D
                                        29 01 00 00 00 00 02 83 00
                                        29 01 00 00 00 00 02 84 9D
                                        29 01 00 00 00 00 02 85 00
                                        29 01 00 00 00 00 02 86 AC
                                        29 01 00 00 00 00 02 87 00
                                        29 01 00 00 00 00 02 88 DF
                                        29 01 00 00 00 00 02 89 01
                                        29 01 00 00 00 00 02 8A 05
                                        29 01 00 00 00 00 02 8B 01
                                        29 01 00 00 00 00 02 8C 3F
                                        29 01 00 00 00 00 02 8D 01
                                        29 01 00 00 00 00 02 8E 6A
                                        29 01 00 00 00 00 02 8F 01
                                        29 01 00 00 00 00 02 90 AB
                                        29 01 00 00 00 00 02 91 01
                                        29 01 00 00 00 00 02 92 DE
                                        29 01 00 00 00 00 02 93 01
                                        29 01 00 00 00 00 02 94 E0
                                        29 01 00 00 00 00 02 95 02
                                        29 01 00 00 00 00 02 96 10
                                        29 01 00 00 00 00 02 97 02
                                        29 01 00 00 00 00 02 98 4D
                                        29 01 00 00 00 00 02 99 02
                                        29 01 00 00 00 00 02 9A 76
                                        29 01 00 00 00 00 02 9B 02
                                        29 01 00 00 00 00 02 9C B1
                                        29 01 00 00 00 00 02 9D 02
                                        29 01 00 00 00 00 02 9E DD
                                        29 01 00 00 00 00 02 9F 03
                                        29 01 00 00 00 00 02 A0 16
                                        29 01 00 00 00 00 02 A2 03
                                        29 01 00 00 00 00 02 A3 20
                                        29 01 00 00 00 00 02 A4 03
                                        29 01 00 00 00 00 02 A5 31
                                        29 01 00 00 00 00 02 A6 03
                                        29 01 00 00 00 00 02 A7 45
                                        29 01 00 00 00 00 02 A9 03
                                        29 01 00 00 00 00 02 AA 5C
                                        29 01 00 00 00 00 02 AB 03
                                        29 01 00 00 00 00 02 AC 77
                                        29 01 00 00 00 00 02 AD 03
                                        29 01 00 00 00 00 02 AE 9A
                                        29 01 00 00 00 00 02 AF 03
                                        29 01 00 00 00 00 02 B0 C6
                                        29 01 00 00 00 00 02 B1 03
                                        29 01 00 00 00 00 02 B2 FF
                                        29 01 00 00 00 00 02 B3 00
                                        29 01 00 00 00 00 02 B4 00
                                        29 01 00 00 00 00 02 B5 00
                                        29 01 00 00 00 00 02 B6 16
                                        29 01 00 00 00 00 02 B7 00
                                        29 01 00 00 00 00 02 B8 36
                                        29 01 00 00 00 00 02 B9 00
                                        29 01 00 00 00 00 02 BA 50
                                        29 01 00 00 00 00 02 BB 00
                                        29 01 00 00 00 00 02 BC 66
                                        29 01 00 00 00 00 02 BD 00
                                        29 01 00 00 00 00 02 BE 7A
                                        29 01 00 00 00 00 02 BF 00
                                        29 01 00 00 00 00 02 C0 8D
                                        29 01 00 00 00 00 02 C1 00
                                        29 01 00 00 00 00 02 C2 9D
                                        29 01 00 00 00 00 02 C3 00
                                        29 01 00 00 00 00 02 C4 AC
                                        29 01 00 00 00 00 02 C5 00
                                        29 01 00 00 00 00 02 C6 DF
                                        29 01 00 00 00 00 02 C7 01
                                        29 01 00 00 00 00 02 C8 05
                                        29 01 00 00 00 00 02 C9 01
                                        29 01 00 00 00 00 02 CA 3F
                                        29 01 00 00 00 00 02 CB 01
                                        29 01 00 00 00 00 02 CC 6A
                                        29 01 00 00 00 00 02 CD 01
                                        29 01 00 00 00 00 02 CE AB
                                        29 01 00 00 00 00 02 CF 01
                                        29 01 00 00 00 00 02 D0 DE
                                        29 01 00 00 00 00 02 D1 01
                                        29 01 00 00 00 00 02 D2 E0
                                        29 01 00 00 00 00 02 D3 02
                                        29 01 00 00 00 00 02 D4 10
                                        29 01 00 00 00 00 02 D5 02
                                        29 01 00 00 00 00 02 D6 4D
                                        29 01 00 00 00 00 02 D7 02
                                        29 01 00 00 00 00 02 D8 76
                                        29 01 00 00 00 00 02 D9 02
                                        29 01 00 00 00 00 02 DA B1
                                        29 01 00 00 00 00 02 DB 02
                                        29 01 00 00 00 00 02 DC DD
                                        29 01 00 00 00 00 02 DD 03
                                        29 01 00 00 00 00 02 DE 16
                                        29 01 00 00 00 00 02 DF 03
                                        29 01 00 00 00 00 02 E0 20
                                        29 01 00 00 00 00 02 E1 03
                                        29 01 00 00 00 00 02 E2 31
                                        29 01 00 00 00 00 02 E3 03
                                        29 01 00 00 00 00 02 E4 45
                                        29 01 00 00 00 00 02 E5 03
                                        29 01 00 00 00 00 02 E6 5C
                                        29 01 00 00 00 00 02 E7 03
                                        29 01 00 00 00 00 02 E8 77
                                        29 01 00 00 00 00 02 E9 03
                                        29 01 00 00 00 00 02 EA 9A
                                        29 01 00 00 00 00 02 EB 03
                                        29 01 00 00 00 00 02 EC C6
                                        29 01 00 00 00 00 02 ED 03
                                        29 01 00 00 00 00 02 EE FF
                                        29 01 00 00 00 00 02 EF 00
                                        29 01 00 00 00 00 02 F0 00
                                        29 01 00 00 00 00 02 F1 00
                                        29 01 00 00 00 00 02 F2 16
                                        29 01 00 00 00 00 02 F3 00
                                        29 01 00 00 00 00 02 F4 36
                                        29 01 00 00 00 00 02 F5 00
                                        29 01 00 00 00 00 02 F6 50
                                        29 01 00 00 00 00 02 F7 00
                                        29 01 00 00 00 00 02 F8 66
                                        29 01 00 00 00 00 02 F9 00
                                        29 01 00 00 00 00 02 FA 7A
                                        29 01 00 00 00 00 02 FF 21
                                        29 01 00 00 00 00 02 FB 01
                                        29 01 00 00 00 00 02 00 00
                                        29 01 00 00 00 00 02 01 8D
                                        29 01 00 00 00 00 02 02 00
                                        29 01 00 00 00 00 02 03 9D
                                        29 01 00 00 00 00 02 04 00
                                        29 01 00 00 00 00 02 05 AC
                                        29 01 00 00 00 00 02 06 00
                                        29 01 00 00 00 00 02 07 DF
                                        29 01 00 00 00 00 02 08 01
                                        29 01 00 00 00 00 02 09 05
                                        29 01 00 00 00 00 02 0A 01
                                        29 01 00 00 00 00 02 0B 3F
                                        29 01 00 00 00 00 02 0C 01
                                        29 01 00 00 00 00 02 0D 6A
                                        29 01 00 00 00 00 02 0E 01
                                        29 01 00 00 00 00 02 0F AB
                                        29 01 00 00 00 00 02 10 01
                                        29 01 00 00 00 00 02 11 DE
                                        29 01 00 00 00 00 02 12 01
                                        29 01 00 00 00 00 02 13 E0
                                        29 01 00 00 00 00 02 14 02
                                        29 01 00 00 00 00 02 15 10
                                        29 01 00 00 00 00 02 16 02
                                        29 01 00 00 00 00 02 17 4D
                                        29 01 00 00 00 00 02 18 02
                                        29 01 00 00 00 00 02 19 76
                                        29 01 00 00 00 00 02 1A 02
                                        29 01 00 00 00 00 02 1B B1
                                        29 01 00 00 00 00 02 1C 02
                                        29 01 00 00 00 00 02 1D DD
                                        29 01 00 00 00 00 02 1E 03
                                        29 01 00 00 00 00 02 1F 16
                                        29 01 00 00 00 00 02 20 03
                                        29 01 00 00 00 00 02 21 20
                                        29 01 00 00 00 00 02 22 03
                                        29 01 00 00 00 00 02 23 31
                                        29 01 00 00 00 00 02 24 03
                                        29 01 00 00 00 00 02 25 45
                                        29 01 00 00 00 00 02 26 03
                                        29 01 00 00 00 00 02 27 5C
                                        29 01 00 00 00 00 02 28 03
                                        29 01 00 00 00 00 02 29 77
                                        29 01 00 00 00 00 02 2A 03
                                        29 01 00 00 00 00 02 2B 9A
                                        29 01 00 00 00 00 02 2D 03
                                        29 01 00 00 00 00 02 2F C6
                                        29 01 00 00 00 00 02 30 03
                                        29 01 00 00 00 00 02 31 FF
                                        29 01 00 00 00 00 02 32 00
                                        29 01 00 00 00 00 02 33 00
                                        29 01 00 00 00 00 02 34 00
                                        29 01 00 00 00 00 02 35 16
                                        29 01 00 00 00 00 02 36 00
                                        29 01 00 00 00 00 02 37 36
                                        29 01 00 00 00 00 02 38 00
                                        29 01 00 00 00 00 02 39 50
                                        29 01 00 00 00 00 02 3A 00
                                        29 01 00 00 00 00 02 3B 66
                                        29 01 00 00 00 00 02 3D 00
                                        29 01 00 00 00 00 02 3F 7A
                                        29 01 00 00 00 00 02 40 00
                                        29 01 00 00 00 00 02 41 8D
                                        29 01 00 00 00 00 02 42 00
                                        29 01 00 00 00 00 02 43 9D
                                        29 01 00 00 00 00 02 44 00
                                        29 01 00 00 00 00 02 45 AC
                                        29 01 00 00 00 00 02 46 00
                                        29 01 00 00 00 00 02 47 DF
                                        29 01 00 00 00 00 02 48 01
                                        29 01 00 00 00 00 02 49 05
                                        29 01 00 00 00 00 02 4A 01
                                        29 01 00 00 00 00 02 4B 3F
                                        29 01 00 00 00 00 02 4C 01
                                        29 01 00 00 00 00 02 4D 6A
                                        29 01 00 00 00 00 02 4E 01
                                        29 01 00 00 00 00 02 4F AB
                                        29 01 00 00 00 00 02 50 01
                                        29 01 00 00 00 00 02 51 DE
                                        29 01 00 00 00 00 02 52 01
                                        29 01 00 00 00 00 02 53 E0
                                        29 01 00 00 00 00 02 54 02
                                        29 01 00 00 00 00 02 55 10
                                        29 01 00 00 00 00 02 56 02
                                        29 01 00 00 00 00 02 58 4D
                                        29 01 00 00 00 00 02 59 02
                                        29 01 00 00 00 00 02 5A 76
                                        29 01 00 00 00 00 02 5B 02
                                        29 01 00 00 00 00 02 5C B1
                                        29 01 00 00 00 00 02 5D 02
                                        29 01 00 00 00 00 02 5E DD
                                        29 01 00 00 00 00 02 5F 03
                                        29 01 00 00 00 00 02 60 16
                                        29 01 00 00 00 00 02 61 03
                                        29 01 00 00 00 00 02 62 20
                                        29 01 00 00 00 00 02 63 03
                                        29 01 00 00 00 00 02 64 31
                                        29 01 00 00 00 00 02 65 03
                                        29 01 00 00 00 00 02 66 45
                                        29 01 00 00 00 00 02 67 03
                                        29 01 00 00 00 00 02 68 5C
                                        29 01 00 00 00 00 02 69 03
                                        29 01 00 00 00 00 02 6A 77
                                        29 01 00 00 00 00 02 6B 03
                                        29 01 00 00 00 00 02 6C 9A
                                        29 01 00 00 00 00 02 6D 03
                                        29 01 00 00 00 00 02 6E C6
                                        29 01 00 00 00 00 02 6F 03
                                        29 01 00 00 00 00 02 70 FF
                                        29 01 00 00 00 00 02 71 00
                                        29 01 00 00 00 00 02 72 00
                                        29 01 00 00 00 00 02 73 00
                                        29 01 00 00 00 00 02 74 16
                                        29 01 00 00 00 00 02 75 00
                                        29 01 00 00 00 00 02 76 36
                                        29 01 00 00 00 00 02 77 00
                                        29 01 00 00 00 00 02 78 50
                                        29 01 00 00 00 00 02 79 00
                                        29 01 00 00 00 00 02 7A 66
                                        29 01 00 00 00 00 02 7B 00
                                        29 01 00 00 00 00 02 7C 7A
                                        29 01 00 00 00 00 02 7D 00
                                        29 01 00 00 00 00 02 7E 8D
                                        29 01 00 00 00 00 02 7F 00
                                        29 01 00 00 00 00 02 80 9D
                                        29 01 00 00 00 00 02 81 00
                                        29 01 00 00 00 00 02 82 AC
                                        29 01 00 00 00 00 02 83 00
                                        29 01 00 00 00 00 02 84 DF
                                        29 01 00 00 00 00 02 85 01
                                        29 01 00 00 00 00 02 86 05
                                        29 01 00 00 00 00 02 87 01
                                        29 01 00 00 00 00 02 88 3F
                                        29 01 00 00 00 00 02 89 01
                                        29 01 00 00 00 00 02 8A 6A
                                        29 01 00 00 00 00 02 8B 01
                                        29 01 00 00 00 00 02 8C AB
                                        29 01 00 00 00 00 02 8D 01
                                        29 01 00 00 00 00 02 8E DE
                                        29 01 00 00 00 00 02 8F 01
                                        29 01 00 00 00 00 02 90 E0
                                        29 01 00 00 00 00 02 91 02
                                        29 01 00 00 00 00 02 92 10
                                        29 01 00 00 00 00 02 93 02
                                        29 01 00 00 00 00 02 94 4D
                                        29 01 00 00 00 00 02 95 02
                                        29 01 00 00 00 00 02 96 76
                                        29 01 00 00 00 00 02 97 02
                                        29 01 00 00 00 00 02 98 B1
                                        29 01 00 00 00 00 02 99 02
                                        29 01 00 00 00 00 02 9A DD
                                        29 01 00 00 00 00 02 9B 03
                                        29 01 00 00 00 00 02 9C 16
                                        29 01 00 00 00 00 02 9D 03
                                        29 01 00 00 00 00 02 9E 20
                                        29 01 00 00 00 00 02 9F 03
                                        29 01 00 00 00 00 02 A0 31
                                        29 01 00 00 00 00 02 A2 03
                                        29 01 00 00 00 00 02 A3 45
                                        29 01 00 00 00 00 02 A4 03
                                        29 01 00 00 00 00 02 A5 5C
                                        29 01 00 00 00 00 02 A6 03
                                        29 01 00 00 00 00 02 A7 77
                                        29 01 00 00 00 00 02 A9 03
                                        29 01 00 00 00 00 02 AA 9A
                                        29 01 00 00 00 00 02 AB 03
                                        29 01 00 00 00 00 02 AC C6
                                        29 01 00 00 00 00 02 AD 03
                                        29 01 00 00 00 00 02 AE FF
                                        29 01 00 00 00 00 02 AF 00
                                        29 01 00 00 00 00 02 B0 00
                                        29 01 00 00 00 00 02 B1 00
                                        29 01 00 00 00 00 02 B2 16
                                        29 01 00 00 00 00 02 B3 00
                                        29 01 00 00 00 00 02 B4 36
                                        29 01 00 00 00 00 02 B5 00
                                        29 01 00 00 00 00 02 B6 50
                                        29 01 00 00 00 00 02 B7 00
                                        29 01 00 00 00 00 02 B8 66
                                        29 01 00 00 00 00 02 B9 00
                                        29 01 00 00 00 00 02 BA 7A
                                        29 01 00 00 00 00 02 BB 00
                                        29 01 00 00 00 00 02 BC 8D
                                        29 01 00 00 00 00 02 BD 00
                                        29 01 00 00 00 00 02 BE 9D
                                        29 01 00 00 00 00 02 BF 00
                                        29 01 00 00 00 00 02 C0 AC
                                        29 01 00 00 00 00 02 C1 00
                                        29 01 00 00 00 00 02 C2 DF
                                        29 01 00 00 00 00 02 C3 01
                                        29 01 00 00 00 00 02 C4 05
                                        29 01 00 00 00 00 02 C5 01
                                        29 01 00 00 00 00 02 C6 3F
                                        29 01 00 00 00 00 02 C7 01
                                        29 01 00 00 00 00 02 C8 6A
                                        29 01 00 00 00 00 02 C9 01
                                        29 01 00 00 00 00 02 CA AB
                                        29 01 00 00 00 00 02 CB 01
                                        29 01 00 00 00 00 02 CC DE
                                        29 01 00 00 00 00 02 CD 01
                                        29 01 00 00 00 00 02 CE E0
                                        29 01 00 00 00 00 02 CF 02
                                        29 01 00 00 00 00 02 D0 10
                                        29 01 00 00 00 00 02 D1 02
                                        29 01 00 00 00 00 02 D2 4D
                                        29 01 00 00 00 00 02 D3 02
                                        29 01 00 00 00 00 02 D4 76
                                        29 01 00 00 00 00 02 D5 02
                                        29 01 00 00 00 00 02 D6 B1
                                        29 01 00 00 00 00 02 D7 02
                                        29 01 00 00 00 00 02 D8 DD
                                        29 01 00 00 00 00 02 D9 03
                                        29 01 00 00 00 00 02 DA 16
                                        29 01 00 00 00 00 02 DB 03
                                        29 01 00 00 00 00 02 DC 20
                                        29 01 00 00 00 00 02 DD 03
                                        29 01 00 00 00 00 02 DE 31
                                        29 01 00 00 00 00 02 DF 03
                                        29 01 00 00 00 00 02 E0 45
                                        29 01 00 00 00 00 02 E1 03
                                        29 01 00 00 00 00 02 E2 5C
                                        29 01 00 00 00 00 02 E3 03
                                        29 01 00 00 00 00 02 E4 77
                                        29 01 00 00 00 00 02 E5 03
                                        29 01 00 00 00 00 02 E6 9A
                                        29 01 00 00 00 00 02 E7 03
                                        29 01 00 00 00 00 02 E8 C6
                                        29 01 00 00 00 00 02 E9 03
                                        29 01 00 00 00 00 02 EA FF
                                        29 01 00 00 00 00 02 FF 10
                                        29 01 00 00 00 00 02 FB 01
                                        29 01 00 00 00 00 02 55 80
                                        29 01 00 00 00 00 02 FF 22
                                        29 01 00 00 00 00 02 FB 01
                                        29 01 00 00 00 00 02 00 00
                                        29 01 00 00 00 00 02 01 00
                                        29 01 00 00 00 00 02 02 00
                                        29 01 00 00 00 00 02 03 00
                                        29 01 00 00 00 00 02 04 00
                                        29 01 00 00 00 00 02 05 04
                                        29 01 00 00 00 00 02 06 08
                                        29 01 00 00 00 00 02 07 0C
                                        29 01 00 00 00 00 02 08 14
                                        29 01 00 00 00 00 02 09 24
                                        29 01 00 00 00 00 02 0A 32
                                        29 01 00 00 00 00 02 0B 41
                                        29 01 00 00 00 00 02 0C 44
                                        29 01 00 00 00 00 02 0D 46
                                        29 01 00 00 00 00 02 0E 34
                                        29 01 00 00 00 00 02 0F 23
                                        29 01 00 00 00 00 02 10 0C
                                        29 01 00 00 00 00 02 11 00
                                        29 01 00 00 00 00 02 12 00
                                        29 01 00 00 00 00 02 13 00
                                        29 01 00 00 00 00 02 1A 00
                                        29 01 00 00 00 00 02 1B 00
                                        29 01 00 00 00 00 02 1C 08
                                        29 01 00 00 00 00 02 1D 14
                                        29 01 00 00 00 00 02 1E 1E
                                        29 01 00 00 00 00 02 1F 2A
                                        29 01 00 00 00 00 02 20 34
                                        29 01 00 00 00 00 02 21 1A
                                        29 01 00 00 00 00 02 22 08
                                        29 01 00 00 00 00 02 23 00
                                        29 01 00 00 00 00 02 24 00
                                        29 01 00 00 00 00 02 25 00
                                        29 01 00 00 00 00 02 26 1A
                                        29 01 00 00 00 00 02 27 28
                                        29 01 00 00 00 00 02 28 2A
                                        29 01 00 00 00 00 02 29 1A
                                        29 01 00 00 00 00 02 2A 00
                                        29 01 00 00 00 00 02 2B 00
                                        29 01 00 00 00 00 02 2F 00
                                        29 01 00 00 00 00 02 30 00
                                        29 01 00 00 00 00 02 31 00
                                        29 01 00 00 00 00 02 32 82
                                        29 01 00 00 00 00 02 33 84
                                        29 01 00 00 00 00 02 34 06
                                        29 01 00 00 00 00 02 35 09
                                        29 01 00 00 00 00 02 36 0C
                                        29 01 00 00 00 00 02 37 0E
                                        29 01 00 00 00 00 02 38 0E
                                        29 01 00 00 00 00 02 39 0C
                                        29 01 00 00 00 00 02 3A 08
                                        29 01 00 00 00 00 02 3B 04
                                        29 01 00 00 00 00 02 3F 00
                                        29 01 00 00 00 00 02 40 00
                                        29 01 00 00 00 00 02 41 00
                                        29 01 00 00 00 00 02 42 00
                                        29 01 00 00 00 00 02 43 00
                                        29 01 00 00 00 00 02 44 00
                                        29 01 00 00 00 00 02 45 00
                                        29 01 00 00 00 00 02 46 00
                                        29 01 00 00 00 00 02 47 00
                                        29 01 00 00 00 00 02 48 00
                                        29 01 00 00 00 00 02 49 00
                                        29 01 00 00 00 00 02 4A 00
                                        29 01 00 00 00 00 02 4B 00
                                        29 01 00 00 00 00 02 4C 84
                                        29 01 00 00 00 00 02 4D 00
                                        29 01 00 00 00 00 02 4E 00
                                        29 01 00 00 00 00 02 4F 00
                                        29 01 00 00 00 00 02 50 00
                                        29 01 00 00 00 00 02 51 00
                                        29 01 00 00 00 00 02 52 00
                                        29 01 00 00 00 00 02 53 01
                                        29 01 00 00 00 00 02 54 01
                                        29 01 00 00 00 00 02 55 99
                                        29 01 00 00 00 00 02 56 04
                                        29 01 00 00 00 00 02 58 00
                                        29 01 00 00 00 00 02 68 00
                                        29 01 00 00 00 00 02 84 00
                                        29 01 00 00 00 00 02 85 00
                                        29 01 00 00 00 00 02 86 00
                                        29 01 00 00 00 00 02 87 80
                                        29 01 00 00 00 00 02 88 07
                                        29 01 00 00 00 00 02 A2 20
                                        29 01 00 00 00 00 02 A9 01
                                        29 01 00 00 00 00 02 AA 00
                                        29 01 00 00 00 00 02 AB 0D
                                        29 01 00 00 00 00 02 AC 07
                                        29 01 00 00 00 00 02 AD 64
                                        29 01 00 00 00 00 02 AF 22
                                        29 01 00 00 00 00 02 B0 02
                                        29 01 00 00 00 00 02 B1 12
                                        29 01 00 00 00 00 02 B2 2F
                                        29 01 00 00 00 00 02 B3 29
                                        29 01 00 00 00 00 02 B4 F0
                                        29 01 00 00 00 00 02 B6 33
                                        29 01 00 00 00 00 02 B7 03
                                        29 01 00 00 00 00 02 B8 00
                                        29 01 00 00 00 00 02 B9 55
                                        29 01 00 00 00 00 02 BA 4A
                                        29 01 00 00 00 00 02 BB A5
                                        29 01 00 00 00 00 02 BD 22
                                        29 01 00 00 00 00 02 BE 02
                                        29 01 00 00 00 00 02 BF 00
                                        29 01 00 00 00 00 02 C0 75
                                        29 01 00 00 00 00 02 C1 6A
                                        29 01 00 00 00 00 02 C2 A5
                                        29 01 00 00 00 00 02 C4 22
                                        29 01 00 00 00 00 02 C5 02
                                        29 01 00 00 00 00 02 C6 00
                                        29 01 00 00 00 00 02 C7 95
                                        29 01 00 00 00 00 02 C8 8A
                                        29 01 00 00 00 00 02 C9 A5
                                        29 01 00 00 00 00 02 CB 22
                                        29 01 00 00 00 00 02 CC 02
                                        29 01 00 00 00 00 02 CD 00
                                        29 01 00 00 00 00 02 CE B5
                                        29 01 00 00 00 00 02 CF AA
                                        29 01 00 00 00 00 02 D0 A5
                                        29 01 00 00 00 00 02 D2 22
                                        29 01 00 00 00 00 02 D3 02
                                        29 01 00 00 00 00 02 FB 01
                                        29 01 00 00 00 00 02 FF 10
                                        29 01 00 00 00 00 02 FB 01
                                        29 01 00 00 00 00 02 9F F7
                                        29 01 00 00 00 00 02 A0 33
                                        29 01 00 00 00 00 02 89 00
                                        29 01 00 00 00 00 02 9D FC
                                        29 01 00 00 00 00 02 A0 32
                                        29 01 00 00 00 00 02 89 00
                                        39 01 00 00 00 00 02 FF 10
                                        39 01 00 00 00 00 02 FB 01
                                        39 01 00 00 00 00 02 B0 01
                                        39 01 00 00 78 00 02 11 00
                                        39 01 00 00 14 00 02 29 00];
		qcom,mdss-dsi-off-command = [39 01 00 00 78 00 02 10 00
					39 01 00 00 20 00 02 28 00];
		qcom,mdss-dsi-on-command-state = "dsi_lp_mode";
		qcom,mdss-dsi-off-command-state = "dsi_hs_mode";
		qcom,mdss-dsi-h-sync-pulse = <1>;
		qcom,mdss-dsi-traffic-mode = "burst_mode";
		qcom,mdss-dsi-lane-map = "lane_map_0123";
		qcom,mdss-dsi-bllp-eof-power-mode;
		qcom,mdss-dsi-bllp-power-mode;
		qcom,mdss-dsi-lane-0-state;
		qcom,mdss-dsi-lane-1-state;
		qcom,mdss-dsi-lane-2-state;
		qcom,mdss-dsi-lane-3-state;
		qcom,mdss-dsi-te-pin-select = <1>;
		qcom,mdss-dsi-te-v-sync-rd-ptr-irq-line = <0x2c>;
		qcom,mdss-dsi-te-dcs-command = <1>;
		qcom,mdss-dsi-te-check-enable;
		qcom,mdss-dsi-te-using-te-pin;
		qcom,mdss-dsi-panel-timings = [E6 38 26 00 68 6E 2A 3C 2C 03 04 00];
		qcom,mdss-dsi-panel-timings-8996 = [24 1f 08 09 05 03 04 a0
		24 1f 08 09 05 03 04 a0
		24 1f 08 09 05 03 04 a0
		24 1f 08 09 05 03 04 a0
		24 1b 08 09 05 03 04 a0];
		qcom,mdss-dsi-t-clk-post = <0x2C>;
		qcom,mdss-dsi-t-clk-pre = <0x2B>;
		qcom,mdss-dsi-bl-min-level = <30>;
		qcom,mdss-dsi-bl-max-level = <4095>;
		qcom,mdss-brightness-max-level = <4095>;
		qcom,mdss-dsi-dma-trigger = "trigger_sw";
		qcom,mdss-dsi-mdp-trigger = "none";
		qcom,mdss-dsi-bl-pmic-control-type = "bl_ctrl_wled";
		qcom,panel-dot-inversion-mode-cmds = [29 01 00 00 00 00 02 FF 24
					29 01 00 00 00 00 02 FB 01
					29 01 00 00 00 00 02 9B 00
					29 01 00 00 00 00 02 FF 10
					29 01 00 00 00 00 02 FB 01];
		qcom,panel-column-inversion-mode-cmds = [29 01 00 00 00 00 02 FF 24
					29 01 00 00 00 00 02 FB 01
					29 01 00 00 00 00 02 9B 0F
					29 01 00 00 00 00 02 FF 10
					29 01 00 00 00 00 02 FB 01];
		qcom,dot-inversion-cmds-dsi-state = "dsi_lp_mode";
		qcom,column-inversion-cmds-dsi-state = "dsi_lp_mode";
		qcom,panel-esd-check-enabled;
		qcom,panel-esd-read-commands = [06 01 00 01 05 00 02 0A 9C];
		qcom,esd-read-cmds-state = "dsi_hs_mode";
		qcom,mdss-dsi-lp11-init;
		qcom,mdss-pan-physical-width-dimension = <62>;
		qcom,mdss-pan-physical-height-dimension = <110>;
		huawei,delaytime-before-bl = <80>;
		huawei,long-read-flag = <1>;
		huawei,reg-read-expect-value = <0x9C>;
		huawei,reg-long-read-count = <3>;
		qcom,mdss-dsi-reset-sequence = <1 10>, <0 5>, <1 10>;

	};
};
